#include <SPI.h>
#include <GU7K.h>
#include <TI_PGA.h>

#define LED_MIN 1
#define LED_MAX 255
#define VFD_MIN 1
#define VFD_MAX 100
#define TI2311_MIN 0
#define TI2311_MAX_NG 192
#define TI2311_MAX_WG 255
#define TI2311_GAIN false
#define AUDIO_CH 2
#define DEBUG true
#define RUN_DEMO true
#define analogPotIn A3
#define analogLedOut 9
#define DownPin 6
#define UpPin 7
#define CSTI2311 13
#define VFDW 140
#define VFDH 8

GU7K_Serial_Async interface(38400, 2, 3, 4);


int valuePot = 0;
int valueLED = 0;
int valueVFD = 0;
int valueTI2311[AUDIO_CH] = {0};
boolean vol_up = false;
boolean FirstRun = true;
boolean vfdinvert = false;
boolean gainTI2311 = false;
boolean mute_status[AUDIO_CH] = {true};
int TI2311_MAX = 0;

Noritake_VFD_GU7K vfd;
TI_PGA ElecVol;

void setupPin() {
    pinMode(analogPotIn, INPUT);
    pinMode(DownPin, OUTPUT);
    digitalWrite(DownPin, LOW);
    pinMode(UpPin, OUTPUT);
    digitalWrite(UpPin, LOW);
}

void setupSerial() {
    Serial.begin(115200);
    if (DEBUG) {
      Serial.println("Debug enabled");
      delay(2000);
    } else {
      Serial.println("Debug disabled");
    }
}

void setupTI2311(){
    if(TI2311_GAIN){
      TI2311_MAX = TI2311_MAX_WG;
    } else if (!TI2311_GAIN) {
      TI2311_MAX = TI2311_MAX_NG;
    }
}


void setupVFD() {
  _delay_ms(500);
  vfd.begin(280, 16);
  vfd.interface(interface);
  vfd.isModelClass(7000);
  vfd.GU7K_reset();
  vfd.GU7K_init();
  for (uint8_t i = 0; i < 2; i++) {
    for (uint8_t j = 0; j < 2; j++) {
      uint8_t k=i*2+j+1;
      vfd.GU7K_defineWindow(k, j*VFDW, i*VFDH, VFDW, VFDH);
      vfd.GU7K_selectWindow(k);
      vfd.GU7K_cursorOff();
      if (DEBUG) {
        vfd.print("Window ");
        vfd.print(k,10);
      }
    }
  }
  if (DEBUG) {
    delay(5000);
  }
  vfd.GU7K_selectWindow(0);
  vfd.GU7K_clearScreen();
}

void setupLogo(unsigned long time_out) {
    const static uint8_t PROGMEM image[] = {
            0x00, 0x00, 0x00, 0x00, 0x10, 0x02, 0x12, 0xc2, 0x15, 0x24, 0x15, 0x24, 0x15, 0x28, 0x15, 0x30,
            0x3f, 0xfe, 0x15, 0x30, 0x15, 0x28, 0x15, 0x24, 0x17, 0xe4, 0x10, 0x02, 0x10, 0x02, 0x00, 0x02,
            0x00, 0x00, 0x10, 0x00, 0x10, 0x04, 0x13, 0xc8, 0x12, 0x50, 0x12, 0x42, 0x12, 0x42, 0x32, 0x7e,
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            0x00, 0x00, 0x00, 0x00, 0x00, 0x00, 0x00, 0x00, 0x00, 0x00, 0x00, 0x00, 0x00, 0x00, 0x00, 0x00
    };
    vfd.GU7K_selectWindow(0);
    vfd.GU7K_drawImage_p(280, 16, image);
    delay(time_out);
    vfd.GU7K_clearScreen();
}

void readPot() {
  valuePot = (int)round(((float)valuePot + (float) (analogRead(analogPotIn) * 4)) / 5);
  if (DEBUG) {
    Serial.print("Pot :");
    Serial.println(valuePot);
  }
}
    
void calcVals(){
  subprocLED(map((long) valuePot, 0, 1023, LED_MIN, (LED_MAX*2)));
  if (DEBUG) {
    Serial.print("LED :");
    Serial.println(valueLED);
  }
  subprocVFD(map((long) valuePot, 0, 1023, VFD_MIN, (VFD_MAX*2)));
  if (DEBUG) {
    Serial.print("VFD :");
    Serial.println(valueVFD);
  }
  subprocTI2311(map((long) valuePot, 0, 1023, TI2311_MIN, TI2311_MAX), mute_status[AUDIO_CH]);
  if (DEBUG) {
    Serial.print("2311:");
    Serial.println(valueTI2311);
  }
  if (DEBUG) {
    Serial.print("\n");
    delay(100);
  }
} 

void subprocLED(int reading) {
    valueLED=constrain(reading, LED_MIN, LED_MAX);
    analogWrite(analogLedOut, valueLED);
}

void subprocVFD(int reading) {
    valueVFD=constrain(reading, VFD_MIN, VFD_MAX);
    if (valueVFD == VFD_MAX) {
        vfdinvert = true;
        vfd.GU7K_invertOn();
    } else {
        vfdinvert = false;
        vfd.GU7K_invertOff();
    }
    vfd.GU7K_setScreenBrightness(valueVFD);
}

void subprocTI2311(int reading, boolean mute[]) {
    static int vol_prev;
    if (vol_prev != reading) {
        //ElecVol.PGA231x_Transfer(CSTI2311, valueTI2311, valueTI2311);
        vol_prev = reading;
    }
}

void printVFD() {
    static char out_buff[4][40];
    static String vfd_out[4];
    static String vfd_old[4];
    static boolean vfdinvert_old;
    if (FirstRun){
      for (uint8_t i = 0; i < 2; i++) {
        for (uint8_t j = 0; j < 2; j++) {
          uint8_t k=i*2+j+1;
          vfd.GU7K_selectWindow(k);
          vfd.GU7K_clearScreen();
        }
      }
      FirstRun = false;
    }
    vfd_out[0]=(String("Pot :")+String(valuePot));
    vfd_out[1]=(String("VFD :")+String(valueVFD));
    vfd_out[2]=(String("2311:")+String(valueTI2311));
    vfd_out[3]=String("This is Window 4");
    for (int i = 0; i < 4; i++) {
      int space = 20 - vfd_out[i].length();
      for (int j = 0; j < space; j++) {
        vfd_out[i]=vfd_out[i]+String(" ");
      }
    }
    for (int i = 0; i < 4; i++) {
      if(vfdinvert_old!=vfdinvert){
        
      }
      if((!(vfd_old[i].equals(vfd_out[i])))||(vfdinvert_old!=vfdinvert)){
        int j = i+1;
        vfd_out[i].toCharArray(out_buff[i], vfd_out[i].length() + 1);
        vfd.GU7K_selectWindow(j);
        vfd.println(out_buff[i]);
        vfd_old[i]=vfd_out[i];
      }
    }
    vfdinvert_old=vfdinvert;
}



void loopDemo() {
    if (RUN_DEMO) {
        if (vol_up) {

            digitalWrite(UpPin, HIGH);
            if (valuePot == 1023) {
                digitalWrite(UpPin, LOW);
                vol_up = false;
                delay(2000);
            };
        }
        if (!vol_up) {
            digitalWrite(DownPin, HIGH);
            if (valuePot == 0) {
                digitalWrite(DownPin, LOW);
                vol_up = true;
                delay(2000);
            };
        }
    }
}






void setup() {
    setupPin();
    setupSerial();
    setupTI2311();
    setupVFD();
    setupLogo(3000);
    readPot();
    calcVals();
    FirstRun = true;
}

void loop() {
    loopDemo();
    readPot();
    calcVals();
    printVFD();
}
